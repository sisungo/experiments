## experiments/trustedcell/linux/security/trustedcell/Kconfig
```kconfig
# SPDX-License-Identifier: GPL-2.0-only

config SECURITY_TRUSTEDCELL
        bool "TrustedCell support"
        depends on SECURITY
        select SECURITYFS
        select SECURITY_PATH
```
